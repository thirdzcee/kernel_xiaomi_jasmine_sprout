#include "msm-audio-jasmine.dtsi"
#include "msm-pm660-jasmine.dtsi"
#include "msm-pm660l-jasmine.dtsi"
#include "sdm660-audio-jasmine.dtsi"
#include "sdm660-blsp-jasmine.dtsi"
#include "sdm660-camera-jasmine.dtsi"
#include "sdm660-camera-sensor-mtp-jasmine.dtsi"
#include "sdm660-common-jasmine.dtsi"
#include "sdm660-internal-codec-jasmine.dtsi"
#include "sdm660-jasmine.dtsi"
#include "sdm660-mdss-panels-jasmine.dtsi"
#include "sdm660-mtp-jasmine.dtsi"
#include "sdm660-pinctrl-jasmine.dtsi"
#include "sdm660-regulator-jasmine.dtsi"
