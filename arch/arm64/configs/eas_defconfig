## arch/arm64/configs/eas_defconfig
```kconfig
CONFIG_DEFAULT_USE_ENERGY_AWARE=y
CONFIG_CPU_FREQ_GOV_SCHEDUTIL=y
CONFIG_CPU_FREQ_GOV_INTERACTIVE=n
CONFIG_CPU_BOOST=n
CONFIG_PELT_UTIL_HALFLIFE_16=y
CONFIG_WQ_POWER_EFFICIENT_DEFAULT=y
CONFIG_STUNE_ASSIST=y
CONFIG_CPUSET_ASSIST=y
CONFIG_ENERGY_MODEL=y
CONFIG_LEGACY_ENERGY_MODEL_DT=y
CONFIG_LEGACY_EM_FREQ_TUPLE=y
CONFIG_MSM_PERFORMANCE_HOTPLUG_ON=y
CONFIG_MSM_PERFORMANCE_CPUFREQ_LIMITS_VOTING_ONLY=y
```

## arch/arm64/configs/memeui_defconfig
```kconfig
include wayne_defconfig
include neocore_defconfig

CONFIG_MEMEUI=y
CONFIG_MACH_XIAOMI_NEW_CAMERA=n
```

## arch/arm64/configs/neocore_defconfig
```kconfig
#include stock config from org
include wayne_defconfig

#NeOcOrE starts here... LOL
CONFIG_NTFS_FS=y
CONFIG_NTFS_RW=y
CONFIG_CPU_FREQ_GOV_POWERSAVE=n
CONFIG_CPU_FREQ_GOV_USERSPACE=n
CONFIG_CPU_FREQ_GOV_ONDEMAND=n
CONFIG_CPU_FREQ_GOV_CONSERVATIVE=n
CONFIG_TCP_CONG_ADVANCED=y
CONFIG_TCP_CONG_WESTWOOD=n
CONFIG_TCP_CONG_CDG=y
CONFIG_DEFAULT_CDG=y
CONFIG_DEFAULT_TCP_CONG="cdg"
CONFIG_NET_SCH_FQ=y
CONFIG_NET_SCH_HTB=n
CONFIG_NET_SCH_MULTIQ=n
CONFIG_NET_SCH_INGRESS=n
CONFIG_USB_CONFIGFS_MASS_STORAGE=y
CONFIG_SCSI_UFSHCD=n
CONFIG_SCSI_UFSHCD_PLATFORM=n
CONFIG_BOUNCE=n
CONFIG_IP_NF_TARGET_TTL=y
CONFIG_PPP=n
CONFIG_HDCP_QSEECOM=n
CONFIG_CPU_IDLE_GOV_LADDER=n
CONFIG_CPU_IDLE_GOV_MENU=n
CONFIG_AUDIT=n
CONFIG_QCOM_SHOW_RESUME_IRQ=n
CONFIG_PROFILING=n
CONFIG_ARM_MEMLAT_MON=n
CONFIG_CPUSETS_ASSIST=y
CONFIG_LOCALVERSION_AUTO=y
CONFIG_BLK_DEV_MD=n
CONFIG_DEBUG_FS=n
CONFIG_IOSCHED_DEADLINE=n
CONFIG_IOSCHED_BFQ=n
CONFIG_SDFAT_DEBUG=n
```
